## components/nvs_configurator/Kconfig.projbuild
```kconfig
menu "NVS Configuration"

	config GROUP_ADD
		string "ble mesh common group address"
		default "0xC000"
	config GROUP1_ADD
		string "ble mesh group-1 address"
		default "0xC001"
	config GROUP2_ADD
		string "ble mesh group-2 address"
		default "0xC002"
	config GROUP3_ADD
		string "ble mesh group-3 address"
		default "0xC003"
	config CONSOLE_MAX_COMMAND_LINE_LENGTH
		int "Maximum command line length"
		default 1024
		help
			This value marks the maximum length of a single command line. Once it is
			reached, no more characters will be accepted by the console.
	config PROMPT_STR
		string "console prompt"
		default "jay"
endmenu
```

## packages/ble_onoff_server/main/Kconfig.projbuild
```kconfig
menu "Example Configuration"

    choice PROJECT_TYPE
        prompt "Project selection"
        default EXTENDED_PROJECT
        help
            Select the option to choose the type of project. The default is EXTENDED

        config EXAMPLE_PROJECT
            bool "EXAMPLE"

        config EXTENDED_PROJECT
            bool "EXTENDED"
    endchoice


    choice BLE_MESH_EXAMPLE_BOARD
        prompt "Board selection for BLE Mesh"
        default BLE_MESH_ESP_WROOM_32 if IDF_TARGET_ESP32
        default BLE_MESH_ESP32C3_DEV if IDF_TARGET_ESP32C3
        default BLE_MESH_ESP32S3_DEV if IDF_TARGET_ESP32S3
        default BLE_MESH_ESP32C6_DEV if IDF_TARGET_ESP32C6
        default BLE_MESH_ESP32H2_DEV if IDF_TARGET_ESP32H2
        help
            Select this option to choose the board for BLE Mesh. The default is ESP32-WROOM-32

        config BLE_MESH_ESP_WROOM_32
            bool "ESP32-WROOM-32"
            depends on IDF_TARGET_ESP32

        config BLE_MESH_ESP_WROVER
            bool "ESP32-WROVER"
            depends on IDF_TARGET_ESP32

        config BLE_MESH_ESP32C3_DEV
            bool "ESP32C3-DevKitC"
            depends on IDF_TARGET_ESP32C3

        config BLE_MESH_ESP32S3_DEV
            bool "ESP32S3-DevKitC"
            depends on IDF_TARGET_ESP32S3

        config BLE_MESH_ESP32C6_DEV
            bool "ESP32C6-DevKitC"
            depends on IDF_TARGET_ESP32C6

        config BLE_MESH_ESP32H2_DEV
            bool "ESP32H2-DevKitC"
            depends on IDF_TARGET_ESP32H2

    endchoice

endmenu
```
